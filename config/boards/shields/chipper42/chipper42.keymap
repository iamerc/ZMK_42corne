/* source keypos definitions */
#include "../../../zmk-nodefree-config/keypos_def/keypos_42keys.h"

/* map 6 extra keys */
#define X_LT  &kp TAB
#define X_LM  &kp CAPSLOCK
#define X_LB  &kp LSHIFT
#define X_RT  &kp BACKSPACE
#define X_RM  &kp RET
#define X_RB  &kp RALT

/* activate bluetooth */
#define CONFIG_WIRELESS 1

/* source the main keymap */
#include "../../../base.keymap"

/* use 6-column layout*/
/ { chosen { zmk,matrix_transform = &default_transform; }; };


